## boards/m5stack/m5stack_papermono/Kconfig.m5stack_papermono
```kconfig
# SPDX-License-Identifier: MIT

config BOARD_M5STACK_PAPERMONO
	select SOC_ESP32S3_WROOM_N16R8
	select SOC_ESP32S3_PROCPU if BOARD_M5STACK_PAPERMONO_ESP32S3_PROCPU
```

## boards/m5stack/m5stack_papermono/board.yml
```yaml
board:
  name: m5stack_papermono
  full_name: M5Stack PaperMono C153
  vendor: m5stack
  socs:
    - name: esp32s3
```

## boards/m5stack/m5stack_papermono/m5stack_papermono_esp32s3_procpu_defconfig
```kconfig
# SPDX-License-Identifier: MIT

CONFIG_CONSOLE=y
CONFIG_SERIAL=y
CONFIG_UART_CONSOLE=y
CONFIG_GPIO=y
CONFIG_CLOCK_CONTROL=y
```

## dts/bindings/misc/m5stack,papermono-sd-slot-control.yaml
```yaml
# SPDX-License-Identifier: MIT

description: M5Stack PaperMono microSD slot board control signals

compatible: "m5stack,papermono-sd-slot-control"

properties:
  detect-gpios:
    type: phandle-array
    required: true
    description: Active-low card-detect input routed through M5IOE1 IO1
```

## dts/bindings/misc/m5stack,papermono-st25r3916.yaml
```yaml
# SPDX-License-Identifier: MIT

description: PaperMono board-integrated ST25R3916 NFC front end

compatible: "m5stack,papermono-st25r3916"

include: i2c-device.yaml

properties:
  power-gpios:
    type: phandle-array
    required: true
    description: Load-switch enable for the NFC daughterboard power rail

  irq-gpios:
    type: phandle-array
    required: true
    description: Active-high ST25R3916 interrupt output

  power-on-delay-ms:
    type: int
    default: 50
    description: Delay before the first identity-register access
```

## dts/bindings/pwm/m5stack,m5ioe1-pwm.yaml
```yaml
# SPDX-License-Identifier: MIT

description: PWM function of an M5Stack M5IOE1 expander

compatible: "m5stack,m5ioe1-pwm"

include: pwm-controller.yaml

properties:
  "#pwm-cells":
    const: 2

  channels:
    const: 4

pwm-cells:
  - channel
  - period
```

## dts/bindings/pwm/m5stack,m5pm1-pwm.yaml
```yaml
# SPDX-License-Identifier: MIT

description: PWM function of an M5Stack M5PM1 power manager

compatible: "m5stack,m5pm1-pwm"

include: pwm-controller.yaml

properties:
  "#pwm-cells":
    const: 2

  channels:
    const: 2

pwm-cells:
  - channel
  - period
```

## dts/bindings/sensor/bosch,bmi270-base.yaml
```yaml
# SPDX-License-Identifier: Apache-2.0

description: |
  Bosch BMI270 using the base feature configuration.  This configuration is
  required for the any-motion feature routed through INT1.

compatible: "bosch,bmi270-base"

include: [i2c-device.yaml, "bosch,bmi270.yaml"]
```
